## components/__config/Kconfig.projbuild
```kconfig
menu "IoT Solution settings"
    config IOT_SOLUTION_EMBED
        bool
        default y
    menu "IoT Components Management"
        menu "General functions"
            config IOT_PARAM_ENABLE
                bool "PARAM_FUNC_ENABLE"
                default n
                help
                    "Select this one to enable PARAM FUNC"    

        config IOT_BUTTON_ENABLE
                bool "BUTTON_DEVICE_ENABLE"
                default y
                help
                    "Select this one to enable button device"
                    
                menu "Button"
                depends on IOT_BUTTON_ENABLE
                    config IO_GLITCH_FILTER_TIME_MS
                        int "IO glitch filter timer ms (10~100)"
                        range 10 100
                        default 50
                endmenu  
        endmenu
        menu "SPI devices"
            config IOT_LCD_ENABLE
                bool "SPI_LCD_ENABLE"
                default y
                help
                    "Select this one to enable SPI LCD device" 
            config IOT_TOUCH_SCREEN_ENABLE
                bool "SPI_TOUCH_SCERRN_ENABLE"
                default y
                help
                    "Select this one to enable SPI TOUCH SCREEN device"
        endmenu
        
        menu "HMI Components"

            choice GUI_LIB_SELECT
                prompt "GUI Library Select"
                default SELECT_NONE
                
                config LVGL_GUI_ENABLE
                    bool "LittlevGL GUI Enable"

                config SELECT_NONE
                    bool "Select None"

            endchoice

            menu "LVGL settings"
                depends on LVGL_GUI_ENABLE

                config LVGL_USE_CUSTOM_DRIVER
                    bool "Use Custom Driver Defined By Users"
                    default n
                    help 
                        Select to use your own LCD driver. Instead, the driver in lvgl will be used.
                        Sometimes the driver need to be modified or re-written, users can choose this option and 
                        define their own driver in an independent component. 

                config LVGL_CUSTOM_DRIVER_COMPONENT_NAME
                    string "LittlevGL Custom Driver Component Name"
                    depends on LVGL_USE_CUSTOM_DRIVER
                    default "lvgl_custom_driver"
                    help
                        Sometimes the driver need to be modified or re-written, users can choose this option and 
                        define their own driver in an independent component. 
                        Set this path to the cumtom board driver under project path, 
                        default path is $(PROJECT_PATH)/lvgl_custom_driver

                config LVGL_CUSTOM_DRIVER_KEEP_OPTIONS
                    bool "LittlevGL Custom Driver Keep The Same Options"
                    depends on LVGL_USE_CUSTOM_DRIVER
                    default y
                    help
                        Sometimes the driver need to be modified or re-written, users can choose this option and 
                        define their own driver in an independent component. 
                        Select this to enable the same options as the default driver
                    
                config LVGL_USE_CONFIGURED_OPTIONS
                    bool
                    default y if !LVGL_USE_CUSTOM_DRIVER
                    default y if LVGL_CUSTOM_DRIVER_KEEP_OPTIONS
                    default n

                                            
                config LVGL_DRIVER_TOUCH_SCREEN_ENABLE
                    bool "LittlevGL Touch Screen Enable"
                    default y
                    help 
                        "Select to enable LittlevGL touch screen"

                choice LVGL_DRIVER_MODE
                    prompt "Display Driver Mode"
                    default LVGL_LCD_DRIVER_FRAMEBUFFER_MODE

                    config LVGL_LCD_DRIVER_FRAMEBUFFER_MODE
                        bool "Select LittlevGL Driver Buffered Mode"
                    config LVGL_LCD_DRIVER_API_MODE
                        bool "Select LittlevGL Driver Unbuffered Mode" 

                endchoice
                                        
                config LVGL_DRIVER_AUTO_FLUSH_INTERVAL
                    #depends on LVGL_LCD_DRIVER_FRAMEBUFFER_MODE
                    int "LittlevGL Driver Auto Flush Interval(ms)"
                    range 0 500
                    default 50
                    help 
                        "Select to set the minimum screen flush interval for framebuffer mode"
                                        
                config LVGL_DRIVER_DOUBLE_BUFFER_ENABLE
                    depends on LVGL_LCD_DRIVER_FRAMEBUFFER_MODE
                    bool "LittlevGL Driver Double Buffer Enable"
                    default n
                    help 
                        "Enable Double Buffer For LittlevGL"

                 config LVGL_DRIVER_BUFFER_HEAP_ALLOCATION
                    depends on LVGL_LCD_DRIVER_FRAMEBUFFER_MODE
                    bool "LittlevGL Driver Buffer HEAP alloc Enable"
                    default n
                    help 
                        "Enable Buffer allocation in HEAP memmory"

                choice LVGL_DISP_ROTATE
                    prompt "Choose Screen Rotate"
                    default LVGL_DISP_ROTATE_90

                    config LVGL_DISP_ROTATE_0
                        bool "GDISP_ROTATE_0"

                    config LVGL_DISP_ROTATE_90
                        bool "GDISP_ROTATE_90"

                    config LVGL_DISP_ROTATE_180
                        bool "GDISP_ROTATE_180"

                    config LVGL_DISP_ROTATE_270
                        bool "GDISP_ROTATE_270"
                        
                endchoice

                menu "Config Driver"
                    depends on LVGL_USE_CONFIGURED_OPTIONS
                       
                    choice LVGL_DRIVER_TOUCH_SCREEN
                        prompt "Choose Touch Screen Driver"
                        depends on LVGL_DRIVER_TOUCH_SCREEN_ENABLE
                        
                        config LVGL_DRIVER_TOUCH_XPT2046
                            bool "XPT2046"
                        
                    endchoice
                
                    menu "XPT2046 Touch Screen Pin Configuration"
                        depends on LVGL_DRIVER_TOUCH_XPT2046

                        config LVGL_TOUCH_CS_GPIO
                            int "LittlevGL Touch CS GPIO"
                            range 0 39
                            default 32
                        config LVGL_TOUCH_IRQ_GPIO
                            int "LittlevGL Touch IRQ GPIO"
                            range 0 39
                            default 33

                    endmenu
                
                    
                    choice LVGL_DRIVER_SCREEN
                        depends on LVGL_USE_CONFIGURED_OPTIONS
                        prompt "Choose Screen Driver"
                        default LVGL_DRIVER_ILI9341
                        help
                            CHOOSE SCREEN DRIVER.
                        
                        config LVGL_DRIVER_ILI9341
                            bool "ILI9341"
                    endchoice

                    menu "ILI9341 Screen Pin Configuration"
                        depends on LVGL_DRIVER_ILI9341

                        choice LVGL_LCD_SPI_SELECT
                            prompt "Select SPI Port"
                            default LVGL_LCD_HSPI
                        
                            config LVGL_LCD_HSPI
                                bool "Select HSPI"

                            config LVGL_LCD_VSPI
                                bool "Select VSPI"

                        endchoice
                        config LVGL_LCD_SPI_NUM
                            int
                            default 1 if  LVGL_LCD_HSPI
                            default 2 if  LVGL_LCD_VSPI
                        config LVGL_LCD_SPI_CLOCK
                            int "LittlevGL LCD SPI Clock"
                            range 0 40000000
                            default 20000000

                        config LVGL_LCD_MISO_GPIO
                            int "LittlevGL LCD MISO GPIO"
                            range 0 39
                            default 27
                        config LVGL_LCD_MOSI_GPIO
                            int "LittlevGL LCD MOSI GPIO"
                            range 0 39
                            default 21
                        config LVGL_LCD_CLK_GPIO
                            int "LittlevGL LCD CLK GPIO"
                            range 0 39
                            default 22
                        config LVGL_LCD_CS_GPIO
                            int "LittlevGL LCD CS GPIO"
                            range 0 39
                            default 5
                        config LVGL_LCD_DC_GPIO
                            int "LittlevGL LCD DC GPIO"
                            range 0 39
                            default 19
                        config LVGL_LCD_RESET_GPIO
                            int "LittlevGL LCD RESET GPIO"
                            range 0 39
                            default 18
                        config LVGL_LCD_BL_GPIO
                            int "LittlevGL LCD BL GPIO"
                            range 0 39
                            default 23

                    endmenu

                    config ILI9341_LVGL_DRIVER_SCREEN_WIDTH
                        depends on LVGL_DRIVER_ILI9341
                        int "LittlevGL Screen Width (pixels)"
                        range 0 5000
                        default 240
                        help
                            "LittlevGL Screen Width (pixels)"

                    config ILI9341_LVGL_DRIVER_SCREEN_HEIGHT
                        depends on LVGL_DRIVER_ILI9341
                        int "LittlevGL Screen Height (pixels)"
                        range 0 5000
                        default 320
                        help
                            "LittlevGL Screen Height (pixels)"
                            
                    config LVGL_DRIVER_SCREEN_WIDTH
                        int
                        default ILI9341_LVGL_DRIVER_SCREEN_WIDTH if  LVGL_DRIVER_ILI9341
                            
                    config LVGL_DRIVER_SCREEN_HEIGHT
                        int
                        default ILI9341_LVGL_DRIVER_SCREEN_HEIGHT if  LVGL_DRIVER_ILI9341

                endmenu

            endmenu

        endmenu
        
    endmenu
    
endmenu
```

## main/Kconfig.projbuild
```kconfig
menu "Include simple"
    config LV_CONF_INCLUDE_SIMPLE
        bool
        default y
endmenu
```

## sdkconfig.defaults
```kconfig
# Override defaults here


#
# ESP32-specific config
#

CONFIG_ESP32_DEFAULT_CPU_FREQ_240=y
CONFIG_ESP32_DEFAULT_CPU_FREQ_MHZ=240

FREERTOS_ASSERT_ON_UNTESTED_FUNCTION=n

CONFIG_ESPTOOLPY_FLASHSIZE_4MB=y

#
# Partition Table
#
# CONFIG_PARTITION_TABLE_SINGLE_APP is not set
# CONFIG_PARTITION_TABLE_TWO_OTA is not set
```
